/***********************************************************************
 *   ___  ___  ___  ___  ___  ___   _    ___  _ _ _ 
 *  | . || __>|_ _|| __>| . \/  _> | |  | . || | | |
 *  |   || _>  | | | _> |   /| <_/\| |_ | | || | | |
 *  |_|_||_|   |_| |___>|_\_\`____/|___|`___'|__/_/ 
 *                                                 rp2040
 *      Copyright (c) 2024 bitfield labs
 *
 ***********************************************************************
 *  This file is part of the afterglow pinball LED project:
 *  https://github.com/bitfieldlabs/afterglow
 *
 *  afterglow is free software: you can redistribute it and/or modify
 *  it under the terms of the GNU Lesser General Public License as
 *  published by the Free Software Foundation, either version 3 of the
 *  License, or (at your option) any later version.
 *
 *  afterglow is distributed in the hope that it will be useful,
 *  but WITHOUT ANY WARRANTY; without even the implied warranty of
 *  MERCHANTABILITY or FITNESS FOR A PARTICULAR PURPOSE.  See the
 *  GNU Lesser General Public License for more details.
 *
 *  You should have received a copy of the GNU Lesser General Public
 *  License along with afterglow.
 *  If not, see <http://www.gnu.org/licenses/>.
 ***********************************************************************/

#include <string.h>
#include "display.h"
#include "pico/stdlib.h"
#include "pico/time.h"
#include "ssd1306.h"

#if DEBUG_OLED_I2C

#include "hardware/i2c.h"
#include "def.h"
#include "pindef.h"
#include "afterglow.h"
#include "config.h"
#include "record.h"
#include "smart.h"


//------------------------------------------------------------------------------
// local definitions

// Display update interval [us]
#define DISPLAY_UPDATE_INT (200000)


// bitfield labs logo
const unsigned long bfl_logo_size=1170;
unsigned char bfl_logo_data[]={
    0x42,0x4d,0x92,0x04,0x00,0x00,0x00,0x00,0x00,0x00,0x92,0x00,0x00,0x00,0x7c,0x00,
    0x00,0x00,0x80,0x00,0x00,0x00,0x40,0x00,0x00,0x00,0x01,0x00,0x01,0x00,0x00,0x00,
    0x00,0x00,0x00,0x04,0x00,0x00,0x27,0x2e,0x00,0x00,0x27,0x2e,0x00,0x00,0x02,0x00,
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    0xff,0xff
};

const uint8_t font_small_8x5[] =
{
			8, 5, 1, 32, 126,
			0x00, 0x00, 0x00, 0x00, 0x00,
			0x00, 0x00, 0x5F, 0x00, 0x00,
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			0x02, 0x01, 0x02, 0x04, 0x02,
};

const uint8_t acme_font[] = {
	8, 6, 1, 32, 126,
	0x00,0x00,0x00,0x00,0x00,0x00, //  
	0x7f,0x51,0x7f,0x00,0x00,0x00, // !
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	0x00,0x00,0x00,0x00,0x00,0x00
};

const uint8_t BMSPA_font[] = {
	8, 8, 0, 32, 126,
	0x00,0x00,0x00,0x00,0x00,0x00,0x00,0x00, //  
	0x00,0x5f,0x00,0x00,0x00,0x00,0x00,0x00, // !
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	0x00,0x00,0x00,0x00,0x00,0x00,0x00,0x00
};

//------------------------------------------------------------------------------
// local variables

ssd1306_t sDisp;
bool sDispInit = false;
DISPLAY_MODES_t sMainMode = DISPLAY_MODE_LOGO;
uint64_t sLastUpdate = 0;
char sNotice1[64] = "\0";
char sNotice2[64] = "\0";
char sNotice3[64] = "\0";
uint64_t sNoticeStartTime = 0;
uint32_t sNoticeDuration = 0;


//------------------------------------------------------------------------------
void display_setMode(DISPLAY_MODES_t mode)
{
    sMainMode = mode;
}

//------------------------------------------------------------------------------
void display_setNotice(const char *pkStr1, const char *pkStr2, const char *pkStr3, uint32_t duration)
{
    strncpy(sNotice1, pkStr1, 64);
    strncpy(sNotice2, pkStr2, 64);
    strncpy(sNotice3, pkStr3, 64);
    sNoticeStartTime = to_us_since_boot(get_absolute_time());
    sNoticeDuration = duration;
}

//------------------------------------------------------------------------------
bool display_init()
{
    i2c_init(i2c0, 1000000);
    gpio_set_function(AGPIN_D_SDA, GPIO_FUNC_I2C);
    gpio_set_function(AGPIN_D_SCL, GPIO_FUNC_I2C);
    gpio_pull_up(AGPIN_D_SDA);
    gpio_pull_up(AGPIN_D_SCL);

    // check if display is present
    uint8_t addr = 0x3C;
    if (i2c_write_timeout_us(i2c0, addr, &addr, 1, true, 100) == 1)
    {
        sDisp.external_vcc=false;
        sDispInit = ssd1306_init(&sDisp, 128, 64, addr, i2c0);
        if (sDispInit)
        {
            ssd1306_clear(&sDisp);
            ssd1306_bmp_show_image(&sDisp, bfl_logo_data, bfl_logo_size);
            ssd1306_show(&sDisp);
        }
    }
    return sDispInit;
}

//------------------------------------------------------------------------------
static void display_status()
{
    // use the first 16 rows to display status information
    ssd1306_clear_square(&sDisp, 0, 0, 128, 16);

    // mode
    ssd1306_draw_string_with_font(&sDisp, 1,4,1, BMSPA_font,
        (ag_mode() == AG_MODE_WPC) ? "WPC" :
        (ag_mode() == AG_MODE_WHITESTAR) ? "WS" : "???");
    
    // DIP switch indicators
    AG_DIPSWITCH_t ds = cfg_dipSwitch();
    if (ds.testMode)
    {
        ssd1306_draw_string_with_font(&sDisp, 98, 4, 1, acme_font, "T");
    }
    if (ds.replayMode)
    {
        ssd1306_draw_string_with_font(&sDisp, 104, 4, 1, acme_font, "R");
    }
    if (ds.smartMode)
    {
        ssd1306_draw_string_with_font(&sDisp, 110, 4, 1, acme_font, "S");
    }
    if (ds.passThrough)
    {
        ssd1306_draw_string_with_font(&sDisp, 116, 4, 1, acme_font, "P");
    }

    // status
    AFTERGLOW_STATUS_t st = ag_status();
    const char * ag_st_str[] = {"INI", "OK ", "PTR", "TST", "REP", "REA", "REC", "INV" };
    if (st<8)
    {
        ssd1306_draw_string_with_font(&sDisp, 28, 4, 1, BMSPA_font, ag_st_str[st]);
    }
}

//------------------------------------------------------------------------------
void display_update()
{
    // nothing to do if no display
    if (!sDispInit)
    {
        return;
    }

    // keep track of time
    uint64_t ts = to_us_since_boot(get_absolute_time());

    // update the display at low rate only
    if ((ts - sLastUpdate) > DISPLAY_UPDATE_INT)
    {
        // choose a display mode
        if (ts > 3000000)
        {
            if (cfg_dipSwitch().smartMode && (ts < 8000000))
            {
                display_setMode(DISPLAY_MODE_LAMPTYPE);
            }
            else if (cfg_dipSwitch().replayMode)
            {
                if (cfg_dipSwitch().testMode && record_ready())
                {
                    display_setMode(DISPLAY_MODE_RECORDREADY);
                }
                else
                {
                    display_setMode(record_active() ? DISPLAY_MODE_RECORD : DISPLAY_MODE_REPLAY);
                }
            }
        }

        // check for active notice messages
        if ((sNoticeDuration > 0) && ((ts - sNoticeStartTime) < sNoticeDuration))
        {
            display_setMode(DISPLAY_MODE_NOTICE);
        }
        else
        {
            // notice done
            sNoticeDuration = 0;
        }
        
        // status header
        display_status();

        // main display
        switch (sMainMode)
        {
            // blank
            case DISPLAY_MODE_BLANK: ssd1306_clear_square(&sDisp, 0, 16, 128, 48); break;
            
            // logo (already loaded at start)
            case DISPLAY_MODE_LOGO: break;

            // replay mode
            case DISPLAY_MODE_REPLAY:
            {
                // clear
                ssd1306_clear_square(&sDisp, 0, 16, 128, 48);
                ssd1306_draw_string_with_font(&sDisp, 16, 20, 2, BMSPA_font, "Replay");
                uint32_t w = (98 * replay_percentage() / 100);
                ssd1306_draw_empty_square(&sDisp, 15, 49, 100, 6);
                ssd1306_draw_square(&sDisp, 16, 50, w, 4);
            }
            break;

            // record ready
            case DISPLAY_MODE_RECORDREADY:
            {
                // clear
                ssd1306_clear_square(&sDisp, 0, 16, 128, 48);
                ssd1306_draw_string_with_font(&sDisp, 16, 20, 2, BMSPA_font, "RECORD");
                ssd1306_draw_string_with_font(&sDisp, 16, 40, 2, BMSPA_font, "READY");
            }
            break;

            // record mode
            case DISPLAY_MODE_RECORD:
            {
                // clear
                ssd1306_clear_square(&sDisp, 0, 16, 128, 48);
                ssd1306_draw_string_with_font(&sDisp, 16, 20, 2, BMSPA_font, "RECORD");
                uint32_t w = (98 * record_percentage() / 100);
                ssd1306_draw_empty_square(&sDisp, 15, 49, 100, 6);
                ssd1306_draw_square(&sDisp, 16, 50, w, 4);
            }
            break;

            // notice
            case DISPLAY_MODE_NOTICE:
            {
                // clear
                ssd1306_clear_square(&sDisp, 0, 16, 128, 48);
                ssd1306_draw_string_with_font(&sDisp, 16, 20, 2, BMSPA_font, sNotice1);
                ssd1306_draw_string_with_font(&sDisp, 16, 36, 1, BMSPA_font, sNotice2);
                ssd1306_draw_string_with_font(&sDisp, 16, 52, 1, BMSPA_font, sNotice3);
            }
            break;

            // lamp types
            case DISPLAY_MODE_LAMPTYPE:
            {
                ssd1306_clear_square(&sDisp, 0, 16, 128, 48);
                ssd1306_draw_string_with_font(&sDisp, 1, 20, 1, font_small_8x5, "Smart lamps");
                ssd1306_draw_empty_square(&sDisp, 92, 18, 35, 44);
                uint32_t x = 94;
                for (uint32_t c = 0; c<NUM_COL; c++)
                {
                    uint32_t y = 20;
                    for (uint32_t r=0; r<NUM_ROW; r++)
                    {
                        switch (smart_lampType(c, r))
                        {

                            case LAMP_TYPE_TINYLED:
                            case LAMP_TYPE_LED:
                            {
                                ssd1306_draw_pixel(&sDisp, x+1, y+1);
                            }
                            break;
                            case LAMP_TYPE_INC:
                            {
                                ssd1306_draw_empty_square(&sDisp, x, y, 3, 3);
                            }
                            break;
                            case LAMP_TYPE_SHORT:
                            {
                                ssd1306_draw_square(&sDisp, x, y, 3, 3);
                            }
                            break;
                            default: break;
                        }
                        y += 4;
                    }
                    x += 4;
                }
            }
            break;

            default: break;
        }

        // send the update to the display
        ssd1306_show(&sDisp);

        sLastUpdate = ts;
    }
}

#endif // DEBUG_OLED_I2C
